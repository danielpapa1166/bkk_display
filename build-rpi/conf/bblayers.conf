## build-rpi/conf/bblayers.conf
```bitbake
# POKY_BBLAYERS_CONF_VERSION is increased each time build/conf/bblayers.conf
# changes incompatibly
POKY_BBLAYERS_CONF_VERSION = "2"

BBPATH = "${TOPDIR}"
BBFILES ?= ""

BBLAYERS ?= " \
  /data/projects/yocto/poky/meta \
  /data/projects/yocto/poky/meta-poky \
  /data/projects/yocto/poky/meta-yocto-bsp \
  /data/projects/yocto/meta-raspberrypi \
  /data/projects/yocto/meta-openembedded/meta-oe \
  /data/projects/bkk_display/meta-platform-config \
  /data/projects/bkk_display/meta-display-config \
  /data/projects/bkk_display/meta-BKK-api \
  /data/projects/bkk_display/meta-bkk-setup \
  /data/projects/bkk_display/meta-Qt \
  /data/projects/yocto/meta-qt5 \
  /data/projects/bkk_display/build-rpi/workspace \
  "
```

## meta-BKK-api/conf/layer.conf
```bitbake
# We have a conf and classes directory, add to BBPATH
BBPATH .= ":${LAYERDIR}"

# We have recipes-* directories, add to BBFILES
BBFILES += "${LAYERDIR}/recipes-*/*/*.bb \
            ${LAYERDIR}/recipes-*/*/*.bbappend"

BBFILE_COLLECTIONS += "meta-BKK-api"
BBFILE_PATTERN_meta-BKK-api = "^${LAYERDIR}/"
BBFILE_PRIORITY_meta-BKK-api = "6"

LAYERDEPENDS_meta-BKK-api = "core openembedded-layer"
LAYERSERIES_COMPAT_meta-BKK-api = "kirkstone"
```

## meta-Qt/conf/layer.conf
```bitbake
# We have a conf and classes directory, add to BBPATH
BBPATH .= ":${LAYERDIR}"

# We have recipes-* directories, add to BBFILES
BBFILES += "${LAYERDIR}/recipes-*/*/*.bb \
            ${LAYERDIR}/recipes-*/*/*.bbappend"

BBFILE_COLLECTIONS += "meta-Qt"
BBFILE_PATTERN_meta-Qt = "^${LAYERDIR}/"
BBFILE_PRIORITY_meta-Qt = "6"

LAYERDEPENDS_meta-Qt = "core"
LAYERSERIES_COMPAT_meta-Qt = "kirkstone"
```

## meta-bkk-setup/conf/layer.conf
```bitbake
# We have a conf and classes directory, add to BBPATH
BBPATH .= ":${LAYERDIR}"

# We have recipes-* directories, add to BBFILES
BBFILES += "${LAYERDIR}/recipes-*/*/*.bb \
            ${LAYERDIR}/recipes-*/*/*.bbappend"

BBFILE_COLLECTIONS += "meta-bkk-setup"
BBFILE_PATTERN_meta-bkk-setup = "^${LAYERDIR}/"
BBFILE_PRIORITY_meta-bkk-setup = "6"

LAYERDEPENDS_meta-bkk-setup = "core"
LAYERSERIES_COMPAT_meta-bkk-setup = "kirkstone"
```

## meta-display-config/conf/layer.conf
```bitbake
# We have a conf and classes directory, add to BBPATH
BBPATH .= ":${LAYERDIR}"

# We have recipes-* directories, add to BBFILES
BBFILES += "${LAYERDIR}/recipes-*/*/*.bb \
            ${LAYERDIR}/recipes-*/*/*.bbappend"

BBFILE_COLLECTIONS += "meta-display-config"
BBFILE_PATTERN_meta-display-config = "^${LAYERDIR}/"
BBFILE_PRIORITY_meta-display-config = "6"

LAYERDEPENDS_meta-display-config = "core raspberrypi"
LAYERSERIES_COMPAT_meta-display-config = "kirkstone"
```
